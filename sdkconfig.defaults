## sdkconfig.defaults
```kconfig
CONFIG_IDF_TARGET="esp32s3"

CONFIG_ESPTOOLPY_FLASHSIZE_16MB=y
CONFIG_ESPTOOLPY_FLASHMODE_QIO=y

CONFIG_PARTITION_TABLE_CUSTOM=y

CONFIG_ESP_DEFAULT_CPU_FREQ_MHZ_240=y

CONFIG_SPIRAM=y
CONFIG_SPIRAM_MODE_OCT=y
CONFIG_SPIRAM_SPEED_80M=y


###################### esp32_camera recommendations ######################
# see: https://components.espressif.com/components/espressif/esp32-camera/versions/2.1.4/readme
CONFIG_ESPTOOLPY_FLASHFREQ_80M=y
###################### esp32_camera recommendations ######################



################################## LVGL ##################################
CONFIG_LV_COLOR_16_SWAP=y
CONFIG_LV_FONT_MONTSERRAT_12=n
CONFIG_LV_FONT_MONTSERRAT_16=n
CONFIG_LV_FONT_MONTSERRAT_20=y

## LVGL8 ##
CONFIG_LV_MEM_SIZE_KILOBYTES=48
################################## LVGL ##################################




#################### esp_lvgl_adapter recommendations ####################
# see: https://components.espressif.com/components/espressif/esp_lvgl_adapter/versions/0.3.0/readme

# FreeRTOS tick rate (improves timer precision)
CONFIG_FREERTOS_HZ=1000

# LVGL OS integration
CONFIG_LV_OS_FREERTOS=y

# Use standard C library functions
CONFIG_LV_USE_CLIB_MALLOC=y
CONFIG_LV_USE_CLIB_STRING=y
CONFIG_LV_USE_CLIB_SPRINTF=y

# Display refresh rate (in milliseconds, 15ms ≈ 66 FPS)
CONFIG_LV_DEF_REFR_PERIOD=15

# Enable style caching for better performance
CONFIG_LV_OBJ_STYLE_CACHE=y

# S3 optimizations #
CONFIG_SPIRAM_XIP_FROM_PSRAM=y
CONFIG_ESP32S3_INSTRUCTION_CACHE_32KB=y
CONFIG_ESP32S3_DATA_CACHE_64KB=y
CONFIG_ESP32S3_DATA_CACHE_LINE_64B=y

# Enable compiler optimizations
CONFIG_COMPILER_OPTIMIZATION_PERF=y
#################### esp_lvgl_adapter recommendations ####################
```
